#include <REGX52.H>
#include "Timer.h"

sbit ENR=P1^0;
sbit ENL=P1^1;

unsigned int PWMR=0,PWML=0,t=0; 
				//右轮占空比
				//左轮占空比
				//设定的比较值


void Timer0_Init()		//100微秒
{
			
//	TMOD &= 0xF0;	  //1111 0000	
//	TMOD |= 0x02;		
//	TH0 = 0xA4;	 //赋给定时器0  1ms的初值
//	TL0 = 0xA4;		 //TH0和TL0为计数器的高位和低位（计数器最高计到65535，也就是16进制的FFFF）
//	//单片机为8位机，所以分两个八位的寄存器来存储16位的计数器
//	TF0 = 0;		
//	TR0 = 1;		//定时器开始工作
//	EA=1;  //定时器总开关（总中断）
//	ET0=1;  //定时器0的中断允许开关
//	TR0=1; //定时器0的开关，TR0=1表示开定时器。
//	PT0=0; //51单片机中PT0是设置定时器T0为高优先级的控制位，1时为高优先级，0时为低优先级。
	TMOD|=0X01;//选择为定时器0模式，工作方式1，仅用TR0打开启动。

	TH0=(65536-100)/256;	//F=f/12=11.0592M/12=0.9216MHZ   T=1/F=1.085us 
	TL0=(65536-100)%256;	//定时108.5us=0.1ms
	ET0=1;//打开定时器0中断允许
	TR0=1;//打开定时器		
	EA=1;
}



//定时器0中断服务函数
void Timer0_Routinue() interrupt 1
{
//			TH0 = 0xA4;	 //重新赋初值
//			TL0 = 0xA4;		
	TH0=(65536-100)/256; //重新赋初值
	TL0=(65536-100)%256;
			t++;
			if(t<PWML)
				{
					ENL=1;
				}
			else
				{
					ENL=0;
				}
			if(t<PWMR)
				{
					ENR=1;
				}
			else
				{
					ENR=0;
				}
			
			if(t>=100)
				{
					t=0;
				}
}
